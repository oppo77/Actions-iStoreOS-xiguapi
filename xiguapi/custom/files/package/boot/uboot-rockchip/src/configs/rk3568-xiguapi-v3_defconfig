## xiguapi/custom/files/package/boot/uboot-rockchip/src/configs/rk3568-xiguapi-v3_defconfig
```kconfig
CONFIG_ARM=y
CONFIG_ARCH_ROCKCHIP=y
CONFIG_ROCKCHIP_RK3568=y
CONFIG_COUNTER_FREQUENCY=24000000
CONFIG_SKIP_LOWLEVEL_INIT=y
CONFIG_SYS_LOAD_ADDR=0xc00800
CONFIG_ERRNO_STR=y
CONFIG_SYSRESET=y
CONFIG_SPL=y
CONFIG_SPL_FIT=y
CONFIG_FIT=y
CONFIG_OF_LIBFDT=y
CONFIG_OF_CONTROL=y
# CONFIG_ARCH_MISC_INIT is not set
CONFIG_DISPLAY_CPUINFO=y
CONFIG_DISPLAY_BOARDINFO=y
CONFIG_DEFAULT_DEVICE_TREE="rockchip/rk3568-xiguapi-v3"
# CONFIG_OF_BOARD_FIXUP is not set
CONFIG_LEGACY_IMAGE_FORMAT=y
CONFIG_FIT_VERBOSE=y
CONFIG_FIT_SIGNATURE=y
CONFIG_SYS_BOOTM_LEN=0x8000000
CONFIG_BOOTDELAY=3
CONFIG_USE_PREBOOT=y
CONFIG_PREBOOT="echo; echo Welcome to NLNET Xiguapi V3; echo"

# 引导命令配置
CONFIG_BOOTCOMMAND="if mmc dev 1 && mmc dev; then " \
                   "setenv devnum 1; setenv devtype mmc; " \
                   "elif mmc dev 0 && mmc dev; then " \
                   "setenv devnum 0; setenv devtype mmc; " \
                   "else setenv devtype mmc; setenv devnum 0; fi; " \
                   "if ${devtype} dev ${devnum}; then " \
                   "part start ${devtype} ${devnum} 1 kernel_start; " \
                   "part size ${devtype} ${devnum} 1 kernel_size; " \
                   "setexpr kernel_addr_r ${kernel_start} + 0; " \
                   "setexpr fdt_addr_r ${kernel_start} + 0x800000; " \
                   "setexpr ramdisk_addr_r ${kernel_start} + 0x1000000; " \
                   "${devtype} read ${kernel_addr_r} ${kernel_start} ${kernel_size}; " \
                   "bootm ${kernel_addr_r} ${ramdisk_addr_r} ${fdt_addr_r}; " \
                   "fi; reset"

# 引导参数
CONFIG_BOOTARGS="console=ttyS2,115200n8 earlycon=uart8250,mmio32,0xfe660000 " \
                "root=/dev/mmcblk0p2 rootwait rw " \
                "cma=16M@0x40000000-0x41000000 " \
                "clk_ignore_unused " \
                "loglevel=7"

CONFIG_SPL_SERIAL=y
CONFIG_SPL_FIT_SIGNATURE=y
CONFIG_SPL_LOAD_FIT=y
CONFIG_SPL_MAX_SIZE=0x40000
CONFIG_SPL_PAD_TO=0x7f8000
CONFIG_SPL_ATF=y
CONFIG_SPL_ATF_NO_PLATFORM_PARAM=y
CONFIG_SPL_OF_CONTROL=y
CONFIG_SPL_OF_LIBFDT=y
CONFIG_SPL_DM_SEQ_ALIAS=y
CONFIG_SPL_REGMAP=y
CONFIG_SPL_SYSCON=y
CONFIG_SPL_CLK=y
CONFIG_SPL_PINCTRL=y
CONFIG_SPL_PINCTRL_FULL=y
CONFIG_SPL_RAM=y
CONFIG_SPL_STACK_R=y
CONFIG_SPL_STACK_R_MALLOC_SIMPLE_LEN=0x200000
# CONFIG_SPL_BOARD_INIT is not set
CONFIG_DEBUG_UART=y
CONFIG_DEBUG_UART_BASE=0xFE660000
CONFIG_DEBUG_UART_CLOCK=24000000
CONFIG_DEBUG_UART_SHIFT=2
CONFIG_BAUDRATE=115200
CONFIG_SYS_NS16550=y
CONFIG_SYS_NS16550_MEM32=y
CONFIG_SYS_NS16550_CLK=24000000
CONFIG_CONS_INDEX=2
CONFIG_SYS_CONSOLE_IS_IN_ENV=y
CONFIG_SYS_CONSOLE_ENV_OVERWRITE=y
CONFIG_SYS_CONSOLE_INFO_QUIET=y
CONFIG_DM_PMIC=y
CONFIG_PMIC_RK8XX=y
CONFIG_REGULATOR=y
CONFIG_REGULATOR_RK8XX=y
CONFIG_DM_REGULATOR_FIXED=y
CONFIG_DM_REGULATOR_GPIO=y
CONFIG_CMD_PMIC=y
CONFIG_CMD_REGULATOR=y
CONFIG_MMC=y
CONFIG_DM_MMC=y
CONFIG_MMC_DW=y
CONFIG_MMC_DW_ROCKCHIP=y
CONFIG_MMC_SDHCI=y
CONFIG_MMC_SDHCI_SDMA=y
CONFIG_MMC_SDHCI_ROCKCHIP=y
CONFIG_SUPPORT_EMMC_RPMB=y
CONFIG_MMC_WRITE=y
CONFIG_MMC_HS200_SUPPORT=y
CONFIG_MMC_HS400_SUPPORT=y
CONFIG_MMC_HS400_ES_SUPPORT=y
CONFIG_CMD_MMC=y
CONFIG_SPL_MMC_WRITE=y
CONFIG_SPL_LIBDISK_SUPPORT=y
# CONFIG_MMC_SPI is not set
CONFIG_MMC_QUIRKS=y
CONFIG_GENERIC_MMC=y
CONFIG_MMC_BOUNCE_BUFFER=y
CONFIG_PARTITION_TYPE_GUID=y
CONFIG_EFI_PARTITION=y
CONFIG_DOS_PARTITION=y
CONFIG_ISO_PARTITION=y
CONFIG_CMD_PART=y
CONFIG_CMD_GPT=y
CONFIG_RANDOM_UUID=y
CONFIG_NET=y
CONFIG_NETDEVICES=y
CONFIG_ETH=y
CONFIG_DWC_ETH_QOS=y
CONFIG_DWC_ETH_QOS_ROCKCHIP=y
CONFIG_PHYLIB=y
CONFIG_PHY_REALTEK=y
CONFIG_PHY_RTL8211F=y
CONFIG_PHY_GIGE=y
CONFIG_PHY_FIXED=y
CONFIG_MII=y
CONFIG_PHY_MICREL=y
CONFIG_PHY_MICREL_KSZ90X1=y
CONFIG_CMD_MII=y
CONFIG_CMD_PING=y
CONFIG_CMD_DHCP=y
CONFIG_CMD_TFTPBOOT=y
CONFIG_CMD_NFS=y
CONFIG_BOOTP=y
CONFIG_BOOTP_SERVERIP=y
CONFIG_BOOTP_BOOTPATH=y
CONFIG_BOOTP_GATEWAY=y
CONFIG_BOOTP_HOSTNAME=y
CONFIG_BOOTP_PXE=y
CONFIG_BOOTP_PXE_CLIENTARCH=0x16
CONFIG_BOOTP_VCI_STRING="U-Boot.armv8"
CONFIG_PCI=y
CONFIG_DM_PCI=y
CONFIG_PCIE_DW_ROCKCHIP=y
CONFIG_PCI_PNP=y
CONFIG_PCI_SCAN_SHOW=y
CONFIG_PCIE_ECAM=y
CONFIG_CMD_PCI=y
CONFIG_PCIE_DW_MVEBU=y
CONFIG_PCI_ENUM_ONLY_ROOT=y
CONFIG_USB=y
CONFIG_DM_USB=y
CONFIG_USB_XHCI_HCD=y
CONFIG_USB_XHCI_DWC3=y
CONFIG_USB_DWC3=y
CONFIG_USB_DWC3_HOST=y
CONFIG_USB_DWC3_GADGET=y
CONFIG_USB_DWC3_GENERIC=y
CONFIG_USB_STORAGE=y
CONFIG_USB_HOST_ETHER=y
CONFIG_USB_ETHER=y
CONFIG_USB_ETH_CDC=y
CONFIG_USB_ETH_RNDIS=y
CONFIG_CMD_USB=y
CONFIG_CMD_FAT=y
CONFIG_FS_FAT=y
CONFIG_FAT_WRITE=y
CONFIG_DM_VIDEO=y
CONFIG_VIDEO=y
CONFIG_DISPLAY=y
CONFIG_VIDEO_ROCKCHIP=y
CONFIG_VIDEO_BPP8=y
CONFIG_VIDEO_BPP16=y
CONFIG_VIDEO_BPP32=y
CONFIG_VIDEO_LOGO=y
CONFIG_SPLASH_SCREEN=y
CONFIG_SPLASH_SCREEN_ALIGN=y
CONFIG_BMP_16BPP=y
CONFIG_BMP_24BPP=y
CONFIG_BMP_32BPP=y
CONFIG_VIDEO_BMP_RLE8=y
CONFIG_VIDEO_BMP_GZIP=y
CONFIG_DM_SPI=y
CONFIG_SPI=y
CONFIG_ROCKCHIP_SPI=y
CONFIG_SPI_FLASH_BAR=y
CONFIG_CMD_SPI=y
CONFIG_CMD_WLAN=y
CONFIG_DM_PWM=y
CONFIG_PWM=y
CONFIG_PWM_ROCKCHIP=y
CONFIG_CMD_PWM=y
CONFIG_LED=y
CONFIG_DM_LED=y
CONFIG_LED_GPIO=y
CONFIG_LED_BLINK=y
CONFIG_CMD_LED=y
# CONFIG_LED_STATUS is not set
# CONFIG_LED_STATUS_BLUE is not set
CONFIG_DM_KEYBOARD=y
CONFIG_KEYBOARD=y
CONFIG_KEYBOARD_GPIO=y
CONFIG_CMD_KEYBOARD=y
CONFIG_DM_GPIO=y
CONFIG_ROCKCHIP_GPIO=y
CONFIG_PINCTRL=y
CONFIG_PINCTRL_ROCKCHIP=y
CONFIG_PINCTRL_GENERIC=y
CONFIG_CMD_GPIO=y
CONFIG_DM_I2C=y
CONFIG_SYS_I2C_ROCKCHIP=y
CONFIG_CMD_I2C=y
CONFIG_I2C_EEPROM=y
CONFIG_I2C_EDID=y
CONFIG_SYS_I2C_SPEED=100000
CONFIG_SYS_I2C_SLAVE=0x00
CONFIG_DM_ADC=y
CONFIG_SARADC_ROCKCHIP=y
CONFIG_CMD_ADC=y
CONFIG_CLK=y
CONFIG_CLK_SCMI=y
CONFIG_CLK_ROCKCHIP=y
CONFIG_SPL_CLK=y
CONFIG_CMD_CLK=y
CONFIG_DM_RESET=y
CONFIG_RESET_ROCKCHIP=y
CONFIG_RESET_SCMI=y
CONFIG_DM_THERMAL=y
CONFIG_ROCKCHIP_THERMAL=y
CONFIG_FS_EXT4=y
CONFIG_CMD_EXT4=y
CONFIG_CMD_EXT4_WRITE=y
CONFIG_FS_BTRFS=y
CONFIG_FS_CRAMFS=y
CONFIG_FS_SQUASHFS=y
CONFIG_CMD_FS_GENERIC=y
CONFIG_LZMA=y
CONFIG_LZO=y
CONFIG_ZSTD=y
CONFIG_GZIP=y
CONFIG_BZIP2=y
CONFIG_ENV_IS_IN_MMC=y
CONFIG_SYS_MMC_ENV_DEV=0
CONFIG_ENV_OFFSET=0x3f8000
CONFIG_ENV_SIZE=0x8000
CONFIG_SYS_REDUNDAND_ENVIRONMENT=y
CONFIG_ENV_OFFSET_REDUND=0x3fc000
CONFIG_ENV_SIZE_REDUND=0x8000
CONFIG_ENV_OVERWRITE=y
CONFIG_FIT_SIGNATURE=y
CONFIG_FIT_VERBOSE=y
CONFIG_CMD_HASH=y
CONFIG_HASH=y
CONFIG_SHA1=y
CONFIG_SHA256=y
CONFIG_SHA512=y
CONFIG_RSA=y
CONFIG_RSA_VERIFY=y
CONFIG_CMD_RSA=y
CONFIG_CMD_MEMORY=y
CONFIG_CMD_MEMTEST=y
CONFIG_SYS_MEMTEST_START=0x80000000
CONFIG_SYS_MEMTEST_END=0x90000000
CONFIG_CMD_ECHO=y
CONFIG_CMD_SOURCE=y
CONFIG_CMD_RUN=y
CONFIG_CMD_ASKENV=y
CONFIG_CMD_EDITENV=y
CONFIG_CMD_SAVEENV=y
CONFIG_CMD_ENV_EXISTS=y
CONFIG_CMD_EXPORTENV=y
CONFIG_CMD_IMPORTENV=y
CONFIG_CMD_BOOTZ=y
CONFIG_CMD_BOOTI=y
CONFIG_CMD_BOOTM=y
CONFIG_CMD_TIME=y
CONFIG_CMD_TIMER=y
CONFIG_RAM=y
CONFIG_SPL_RAM=y
CONFIG_TPL_RAM=y
CONFIG_ROCKCHIP_DDRCLK_SCPI=y
CONFIG_ROCKCHIP_DRAM_EDB=y
CONFIG_ROCKCHIP_DRAM_DMC=y
CONFIG_ROCKCHIP_DRAM_DDR4=y
CONFIG_ROCKCHIP_DRAM_LPDDR4=y
CONFIG_ROCKCHIP_DRAM_LPDDR4X=y
CONFIG_SYS_MALLOC_LEN=0x2000000
CONFIG_SYS_MALLOC_F_LEN=0x8000
CONFIG_SYS_BOOTM_LEN=0x8000000
CONFIG_SYS_SDRAM_BASE=0x80000000
CONFIG_SYS_INIT_SP_ADDR=0x00c00000
CONFIG_SYS_BOOTPARAMS_LEN=0x200000
CONFIG_SYS_CBSIZE=1024
CONFIG_SYS_MAXARGS=64
CONFIG_SYS_PBSIZE=1049
CONFIG_SYS_BARGSIZE=1024
CONFIG_BOOTMENU=y
CONFIG_AUTOBOOT_MENU_SHOW=y
CONFIG_MENU=y
CONFIG_CMD_BOOTMENU=y
CONFIG_SYS_PROMPT="NLNET-XIGUAPI-V3 => "
CONFIG_IDENT_STRING=" NLNET Xiguapi V3 U-Boot"
CONFIG_VERSION_VARIABLE=y
CONFIG_DM_PMIC_CHARGER=y
CONFIG_CHARGER_GPIO=y
CONFIG_POWER_DOMAIN=y
CONFIG_ROCKCHIP_PM_DOMAINS=y
```
